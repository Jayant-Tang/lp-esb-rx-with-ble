## src/mpsl_esb/Kconfig.mpsl_esb
```kconfig
config ESB
	default y

config ESB_MPSL_TIMESLOT
	default y if ESB

config CLOCK_CONTROL
	default y if ESB

config MPSL_TIMESLOT_SESSION_COUNT
	default 2 if ESB_MPSL_TIMESLOT

config RING_BUFFER
	default y if ESB

config ESB_CLOCK_INIT
	default n if ESB_MPSL_TIMESLOT

config APP_ESB_MPSL_TIMESLOT_RX_INTERVAL_US
	int "ESB PRX MPSL listen interval (us)"
	default 500000
	help
	  Interval between ESB PRX listen windows in microseconds.
	  When non-zero, the patched ESB PRX path requests MPSL NORMAL
	  timeslots at this fixed interval instead of continuously requesting
	  EARLIEST timeslots.

config APP_ESB_MPSL_TIMESLOT_RX_WINDOW_US
	int "ESB PRX MPSL listen window (us)"
	default 5000
	help
	  Approximate duration of each ESB PRX listen window in microseconds.
	  The patched ESB PRX path limits timeslot extensions to approximate
	  this window length. Set to 0 to keep upstream ESB behavior.

module = APP_ESB
module-str = app-esb
source "subsys/logging/Kconfig.template.log_config"
```
